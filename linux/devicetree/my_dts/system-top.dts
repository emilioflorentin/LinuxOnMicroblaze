/*
 * CAUTION: This file is automatically generated by Xilinx.
 * Version: XSCT 2020.2
 * Today is: Tue Jan 20 16:58:30 2026
 */


/dts-v1/;
#include "pl.dtsi"
#include "pcw.dtsi"
/ {
	chosen {
		bootargs = "earlycon";
		stdout-path = "serial0:115200n8";
	};
	aliases {
		serial0 = &axi_uartlite_0;
		serial1 = &mdm_0;
	};
};
